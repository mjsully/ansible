## inventories/sample.yaml
```yaml
sample:
  hosts:
    host-1:
      ansible_host: <IP address or hostname>
      ansible_user: <username>
    host-2:
      ansible_host: <IP address or hostname>
      ansible_user: <username>
  vars:
    inventory_var_1: 'Hello world'
```
